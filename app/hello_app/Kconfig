## app/velaguard_app/Kconfig
```kconfig
#
# VelaGuard - independent industrial edge gateway
#

menuconfig LVX_USE_VELAGUARD
	tristate "VelaGuard industrial edge gateway"
	default n
	depends on GRAPHICS_LVGL && SYSTEM_NSH
	---help---
		Enable the bootable VelaGuard product application for the
		STM32H750B-DK.

if LVX_USE_VELAGUARD

config LVX_VELAGUARD_PRIORITY
	int "VelaGuard UI task priority"
	default 120

config LVX_VELAGUARD_STACKSIZE
	int "VelaGuard UI task stack size"
	default 32768

config LVX_VELAGUARD_INPUT_PATH
	string "VelaGuard touchscreen device path"
	default "/dev/input0"

config VG_UI_PERF_DIAGNOSTICS
	bool "VelaGuard UI performance diagnostics"
	default n
	---help---
		Enable a test-only animation and serial refresh timing summary.
		Keep this disabled for product firmware.

config VG_STM32H7_DMA2D
	bool "STM32H7 DMA2D LVGL fill acceleration"
	default y
	depends on ARCH_CHIP_STM32H750B
	---help---
		Use the STM32H750 Chrom-Art DMA2D engine for eligible LVGL RGB565
		fill tasks. Unsupported tasks continue through software rendering.

config VG_BUILD_MODE
	int "VelaGuard product mode (0=test, 1=production)"
	default 0
	range 0 1
	---help---
		Test mode uses a compile-time Device ID override. Production mode
		derives a stable Device ID from the STM32 96-bit unique ID.

config VG_DEVICE_ID_OVERRIDE
	string "Test-mode Device ID override"
	default "vg-test-001"
	depends on VG_BUILD_MODE = 0

config VG_FIRMWARE_VERSION
	string "VelaGuard firmware version"
	default "0.1.0"

choice
	prompt "VelaGuard acquisition backend"
	default VG_ACQ_BACKEND_MOCK
	---help---
		Mock generates live demo readings without RS485 hardware.
		UART is reserved for issue #02 (/dev/rs485 + nanoMODBUS).

config VG_ACQ_BACKEND_NONE
	bool "None (acquisition not configured)"

config VG_ACQ_BACKEND_MOCK
	bool "Mock temperature (no hardware)"

config VG_ACQ_BACKEND_UART
	bool "UART RS485 (issue #02, not implemented yet)"

endchoice

config VG_ACQ_BACKEND
	int
	default 0 if VG_ACQ_BACKEND_NONE
	default 1 if VG_ACQ_BACKEND_MOCK
	default 2 if VG_ACQ_BACKEND_UART

endif
```
